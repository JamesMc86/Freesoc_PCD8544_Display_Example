# CY8C5868AXI_LP035 register map
File version: 0.1
CY8C58LP
Registers are 8-bit, read-write, no defined reset value unless marked. A register's access mark holds for its fields unless they carry their own. Offsets are from the block's base; lines under a group give offsets from that group; [hi:lo] are bit positions; {n}, {i} and the like mark numbered series; 'fields as' and 'values as' point back to an identical list; <NAME> marks a mode.

## Memory map
0x40006479 LCD_RST size 0x1
0x40006578 Data_CMD_Sel size 0x1

## LCD_RST
Base 0x40006479
0x00 LCD_RST_CONTROL_REG

## Data_CMD_Sel
Base 0x40006578
Registers as LCD_RST (with LCD_RST read as Data_CMD_Sel).
