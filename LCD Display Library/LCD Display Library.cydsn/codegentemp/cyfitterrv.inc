    IF :LNOT::DEF:INCLUDED_CYFITTERRV_INC
INCLUDED_CYFITTERRV_INC EQU 1
    GET cydevicerv.inc
    GET cydevicerv_trm.inc

; LCD_Interface
LCD_Interface__0__MASK EQU 0x10
LCD_Interface__0__PC EQU CYREG_PRT12_PC4
LCD_Interface__0__PORT EQU 12
LCD_Interface__0__SHIFT EQU 4
LCD_Interface__1__MASK EQU 0x08
LCD_Interface__1__PC EQU CYREG_PRT12_PC3
LCD_Interface__1__PORT EQU 12
LCD_Interface__1__SHIFT EQU 3
LCD_Interface__2__MASK EQU 0x80
LCD_Interface__2__PC EQU CYREG_PRT12_PC7
LCD_Interface__2__PORT EQU 12
LCD_Interface__2__SHIFT EQU 7
LCD_Interface__3__MASK EQU 0x20
LCD_Interface__3__PC EQU CYREG_PRT12_PC5
LCD_Interface__3__PORT EQU 12
LCD_Interface__3__SHIFT EQU 5
LCD_Interface__4__MASK EQU 0x40
LCD_Interface__4__PC EQU CYREG_PRT12_PC6
LCD_Interface__4__PORT EQU 12
LCD_Interface__4__SHIFT EQU 6
LCD_Interface__AG EQU CYREG_PRT12_AG
LCD_Interface__BIE EQU CYREG_PRT12_BIE
LCD_Interface__BIT_MASK EQU CYREG_PRT12_BIT_MASK
LCD_Interface__BYP EQU CYREG_PRT12_BYP
LCD_Interface__DM0 EQU CYREG_PRT12_DM0
LCD_Interface__DM1 EQU CYREG_PRT12_DM1
LCD_Interface__DM2 EQU CYREG_PRT12_DM2
LCD_Interface__DR EQU CYREG_PRT12_DR
LCD_Interface__D_C__MASK EQU 0x20
LCD_Interface__D_C__PC EQU CYREG_PRT12_PC5
LCD_Interface__D_C__PORT EQU 12
LCD_Interface__D_C__SHIFT EQU 5
LCD_Interface__INP_DIS EQU CYREG_PRT12_INP_DIS
LCD_Interface__PORT EQU 12
LCD_Interface__PRT EQU CYREG_PRT12_PRT
LCD_Interface__PRTDSI__DBL_SYNC_IN EQU CYREG_PRT12_DBL_SYNC_IN
LCD_Interface__PRTDSI__OE_SEL0 EQU CYREG_PRT12_OE_SEL0
LCD_Interface__PRTDSI__OE_SEL1 EQU CYREG_PRT12_OE_SEL1
LCD_Interface__PRTDSI__OUT_SEL0 EQU CYREG_PRT12_OUT_SEL0
LCD_Interface__PRTDSI__OUT_SEL1 EQU CYREG_PRT12_OUT_SEL1
LCD_Interface__PRTDSI__SYNC_OUT EQU CYREG_PRT12_SYNC_OUT
LCD_Interface__PS EQU CYREG_PRT12_PS
LCD_Interface__RST__MASK EQU 0x40
LCD_Interface__RST__PC EQU CYREG_PRT12_PC6
LCD_Interface__RST__PORT EQU 12
LCD_Interface__RST__SHIFT EQU 6
LCD_Interface__SCE__MASK EQU 0x80
LCD_Interface__SCE__PC EQU CYREG_PRT12_PC7
LCD_Interface__SCE__PORT EQU 12
LCD_Interface__SCE__SHIFT EQU 7
LCD_Interface__SCLK__MASK EQU 0x08
LCD_Interface__SCLK__PC EQU CYREG_PRT12_PC3
LCD_Interface__SCLK__PORT EQU 12
LCD_Interface__SCLK__SHIFT EQU 3
LCD_Interface__SDIN__MASK EQU 0x10
LCD_Interface__SDIN__PC EQU CYREG_PRT12_PC4
LCD_Interface__SDIN__PORT EQU 12
LCD_Interface__SDIN__SHIFT EQU 4
LCD_Interface__SIO_CFG EQU CYREG_PRT12_SIO_CFG
LCD_Interface__SIO_DIFF EQU CYREG_PRT12_SIO_DIFF
LCD_Interface__SIO_HYST_EN EQU CYREG_PRT12_SIO_HYST_EN
LCD_Interface__SIO_REG_HIFREQ EQU CYREG_PRT12_SIO_REG_HIFREQ
LCD_Interface__SLW EQU CYREG_PRT12_SLW

; SPIM_IntClock
SPIM_IntClock__CFG0 EQU CYREG_CLKDIST_DCFG0_CFG0
SPIM_IntClock__CFG1 EQU CYREG_CLKDIST_DCFG0_CFG1
SPIM_IntClock__CFG2 EQU CYREG_CLKDIST_DCFG0_CFG2
SPIM_IntClock__CFG2_SRC_SEL_MASK EQU 0x07
SPIM_IntClock__INDEX EQU 0x00
SPIM_IntClock__PM_ACT_CFG EQU CYREG_PM_ACT_CFG2
SPIM_IntClock__PM_ACT_MSK EQU 0x01
SPIM_IntClock__PM_STBY_CFG EQU CYREG_PM_STBY_CFG2
SPIM_IntClock__PM_STBY_MSK EQU 0x01

; Data_CMD_Sel
Data_CMD_Sel_Sync_ctrl_reg__0__MASK EQU 0x01
Data_CMD_Sel_Sync_ctrl_reg__0__POS EQU 0
Data_CMD_Sel_Sync_ctrl_reg__16BIT_CONTROL_AUX_CTL_REG EQU CYREG_B1_UDB08_09_ACTL
Data_CMD_Sel_Sync_ctrl_reg__16BIT_CONTROL_CONTROL_REG EQU CYREG_B1_UDB08_09_CTL
Data_CMD_Sel_Sync_ctrl_reg__16BIT_CONTROL_COUNT_REG EQU CYREG_B1_UDB08_09_CTL
Data_CMD_Sel_Sync_ctrl_reg__16BIT_COUNT_CONTROL_REG EQU CYREG_B1_UDB08_09_CTL
Data_CMD_Sel_Sync_ctrl_reg__16BIT_COUNT_COUNT_REG EQU CYREG_B1_UDB08_09_CTL
Data_CMD_Sel_Sync_ctrl_reg__16BIT_MASK_MASK_REG EQU CYREG_B1_UDB08_09_MSK
Data_CMD_Sel_Sync_ctrl_reg__16BIT_MASK_PERIOD_REG EQU CYREG_B1_UDB08_09_MSK
Data_CMD_Sel_Sync_ctrl_reg__16BIT_PERIOD_MASK_REG EQU CYREG_B1_UDB08_09_MSK
Data_CMD_Sel_Sync_ctrl_reg__16BIT_PERIOD_PERIOD_REG EQU CYREG_B1_UDB08_09_MSK
Data_CMD_Sel_Sync_ctrl_reg__CONTROL_AUX_CTL_REG EQU CYREG_B1_UDB08_ACTL
Data_CMD_Sel_Sync_ctrl_reg__CONTROL_REG EQU CYREG_B1_UDB08_CTL
Data_CMD_Sel_Sync_ctrl_reg__CONTROL_ST_REG EQU CYREG_B1_UDB08_ST_CTL
Data_CMD_Sel_Sync_ctrl_reg__COUNT_REG EQU CYREG_B1_UDB08_CTL
Data_CMD_Sel_Sync_ctrl_reg__COUNT_ST_REG EQU CYREG_B1_UDB08_ST_CTL
Data_CMD_Sel_Sync_ctrl_reg__MASK EQU 0x01
Data_CMD_Sel_Sync_ctrl_reg__MASK_CTL_AUX_CTL_REG EQU CYREG_B1_UDB08_MSK_ACTL
Data_CMD_Sel_Sync_ctrl_reg__PERIOD_REG EQU CYREG_B1_UDB08_MSK
Data_CMD_Sel_Sync_ctrl_reg__PER_CTL_AUX_CTL_REG EQU CYREG_B1_UDB08_MSK_ACTL

; SPIM_BSPIM
SPIM_BSPIM_BitCounter_ST__16BIT_STATUS_AUX_CTL_REG EQU CYREG_B0_UDB08_09_ACTL
SPIM_BSPIM_BitCounter_ST__16BIT_STATUS_REG EQU CYREG_B0_UDB08_09_ST
SPIM_BSPIM_BitCounter_ST__MASK_REG EQU CYREG_B0_UDB08_MSK
SPIM_BSPIM_BitCounter_ST__MASK_ST_AUX_CTL_REG EQU CYREG_B0_UDB08_MSK_ACTL
SPIM_BSPIM_BitCounter_ST__PER_ST_AUX_CTL_REG EQU CYREG_B0_UDB08_MSK_ACTL
SPIM_BSPIM_BitCounter_ST__STATUS_AUX_CTL_REG EQU CYREG_B0_UDB08_ACTL
SPIM_BSPIM_BitCounter_ST__STATUS_CNT_REG EQU CYREG_B0_UDB08_ST_CTL
SPIM_BSPIM_BitCounter_ST__STATUS_CONTROL_REG EQU CYREG_B0_UDB08_ST_CTL
SPIM_BSPIM_BitCounter_ST__STATUS_REG EQU CYREG_B0_UDB08_ST
SPIM_BSPIM_BitCounter__16BIT_CONTROL_AUX_CTL_REG EQU CYREG_B0_UDB08_09_ACTL
SPIM_BSPIM_BitCounter__16BIT_CONTROL_CONTROL_REG EQU CYREG_B0_UDB08_09_CTL
SPIM_BSPIM_BitCounter__16BIT_CONTROL_COUNT_REG EQU CYREG_B0_UDB08_09_CTL
SPIM_BSPIM_BitCounter__16BIT_COUNT_CONTROL_REG EQU CYREG_B0_UDB08_09_CTL
SPIM_BSPIM_BitCounter__16BIT_COUNT_COUNT_REG EQU CYREG_B0_UDB08_09_CTL
SPIM_BSPIM_BitCounter__16BIT_MASK_MASK_REG EQU CYREG_B0_UDB08_09_MSK
SPIM_BSPIM_BitCounter__16BIT_MASK_PERIOD_REG EQU CYREG_B0_UDB08_09_MSK
SPIM_BSPIM_BitCounter__16BIT_PERIOD_MASK_REG EQU CYREG_B0_UDB08_09_MSK
SPIM_BSPIM_BitCounter__16BIT_PERIOD_PERIOD_REG EQU CYREG_B0_UDB08_09_MSK
SPIM_BSPIM_BitCounter__CONTROL_AUX_CTL_REG EQU CYREG_B0_UDB08_ACTL
SPIM_BSPIM_BitCounter__CONTROL_REG EQU CYREG_B0_UDB08_CTL
SPIM_BSPIM_BitCounter__CONTROL_ST_REG EQU CYREG_B0_UDB08_ST_CTL
SPIM_BSPIM_BitCounter__COUNT_REG EQU CYREG_B0_UDB08_CTL
SPIM_BSPIM_BitCounter__COUNT_ST_REG EQU CYREG_B0_UDB08_ST_CTL
SPIM_BSPIM_BitCounter__MASK_CTL_AUX_CTL_REG EQU CYREG_B0_UDB08_MSK_ACTL
SPIM_BSPIM_BitCounter__PERIOD_REG EQU CYREG_B0_UDB08_MSK
SPIM_BSPIM_BitCounter__PER_CTL_AUX_CTL_REG EQU CYREG_B0_UDB08_MSK_ACTL
SPIM_BSPIM_RxStsReg__16BIT_STATUS_AUX_CTL_REG EQU CYREG_B1_UDB08_09_ACTL
SPIM_BSPIM_RxStsReg__16BIT_STATUS_REG EQU CYREG_B1_UDB08_09_ST
SPIM_BSPIM_RxStsReg__4__MASK EQU 0x10
SPIM_BSPIM_RxStsReg__4__POS EQU 4
SPIM_BSPIM_RxStsReg__5__MASK EQU 0x20
SPIM_BSPIM_RxStsReg__5__POS EQU 5
SPIM_BSPIM_RxStsReg__6__MASK EQU 0x40
SPIM_BSPIM_RxStsReg__6__POS EQU 6
SPIM_BSPIM_RxStsReg__MASK EQU 0x70
SPIM_BSPIM_RxStsReg__MASK_REG EQU CYREG_B1_UDB08_MSK
SPIM_BSPIM_RxStsReg__MASK_ST_AUX_CTL_REG EQU CYREG_B1_UDB08_MSK_ACTL
SPIM_BSPIM_RxStsReg__PER_ST_AUX_CTL_REG EQU CYREG_B1_UDB08_MSK_ACTL
SPIM_BSPIM_RxStsReg__STATUS_AUX_CTL_REG EQU CYREG_B1_UDB08_ACTL
SPIM_BSPIM_RxStsReg__STATUS_CNT_REG EQU CYREG_B1_UDB08_ST_CTL
SPIM_BSPIM_RxStsReg__STATUS_CONTROL_REG EQU CYREG_B1_UDB08_ST_CTL
SPIM_BSPIM_RxStsReg__STATUS_REG EQU CYREG_B1_UDB08_ST
SPIM_BSPIM_TxStsReg__0__MASK EQU 0x01
SPIM_BSPIM_TxStsReg__0__POS EQU 0
SPIM_BSPIM_TxStsReg__16BIT_STATUS_AUX_CTL_REG EQU CYREG_B1_UDB09_10_ACTL
SPIM_BSPIM_TxStsReg__16BIT_STATUS_REG EQU CYREG_B1_UDB09_10_ST
SPIM_BSPIM_TxStsReg__1__MASK EQU 0x02
SPIM_BSPIM_TxStsReg__1__POS EQU 1
SPIM_BSPIM_TxStsReg__2__MASK EQU 0x04
SPIM_BSPIM_TxStsReg__2__POS EQU 2
SPIM_BSPIM_TxStsReg__3__MASK EQU 0x08
SPIM_BSPIM_TxStsReg__3__POS EQU 3
SPIM_BSPIM_TxStsReg__4__MASK EQU 0x10
SPIM_BSPIM_TxStsReg__4__POS EQU 4
SPIM_BSPIM_TxStsReg__MASK EQU 0x1F
SPIM_BSPIM_TxStsReg__MASK_REG EQU CYREG_B1_UDB09_MSK
SPIM_BSPIM_TxStsReg__STATUS_AUX_CTL_REG EQU CYREG_B1_UDB09_ACTL
SPIM_BSPIM_TxStsReg__STATUS_REG EQU CYREG_B1_UDB09_ST
SPIM_BSPIM_sR8_Dp_u0__16BIT_A0_REG EQU CYREG_B0_UDB08_09_A0
SPIM_BSPIM_sR8_Dp_u0__16BIT_A1_REG EQU CYREG_B0_UDB08_09_A1
SPIM_BSPIM_sR8_Dp_u0__16BIT_D0_REG EQU CYREG_B0_UDB08_09_D0
SPIM_BSPIM_sR8_Dp_u0__16BIT_D1_REG EQU CYREG_B0_UDB08_09_D1
SPIM_BSPIM_sR8_Dp_u0__16BIT_DP_AUX_CTL_REG EQU CYREG_B0_UDB08_09_ACTL
SPIM_BSPIM_sR8_Dp_u0__16BIT_F0_REG EQU CYREG_B0_UDB08_09_F0
SPIM_BSPIM_sR8_Dp_u0__16BIT_F1_REG EQU CYREG_B0_UDB08_09_F1
SPIM_BSPIM_sR8_Dp_u0__A0_A1_REG EQU CYREG_B0_UDB08_A0_A1
SPIM_BSPIM_sR8_Dp_u0__A0_REG EQU CYREG_B0_UDB08_A0
SPIM_BSPIM_sR8_Dp_u0__A1_REG EQU CYREG_B0_UDB08_A1
SPIM_BSPIM_sR8_Dp_u0__D0_D1_REG EQU CYREG_B0_UDB08_D0_D1
SPIM_BSPIM_sR8_Dp_u0__D0_REG EQU CYREG_B0_UDB08_D0
SPIM_BSPIM_sR8_Dp_u0__D1_REG EQU CYREG_B0_UDB08_D1
SPIM_BSPIM_sR8_Dp_u0__DP_AUX_CTL_REG EQU CYREG_B0_UDB08_ACTL
SPIM_BSPIM_sR8_Dp_u0__F0_F1_REG EQU CYREG_B0_UDB08_F0_F1
SPIM_BSPIM_sR8_Dp_u0__F0_REG EQU CYREG_B0_UDB08_F0
SPIM_BSPIM_sR8_Dp_u0__F1_REG EQU CYREG_B0_UDB08_F1
SPIM_BSPIM_sR8_Dp_u0__MSK_DP_AUX_CTL_REG EQU CYREG_B0_UDB08_MSK_ACTL
SPIM_BSPIM_sR8_Dp_u0__PER_DP_AUX_CTL_REG EQU CYREG_B0_UDB08_MSK_ACTL

; LCD_RST
LCD_RST_Sync_ctrl_reg__0__MASK EQU 0x01
LCD_RST_Sync_ctrl_reg__0__POS EQU 0
LCD_RST_Sync_ctrl_reg__16BIT_CONTROL_AUX_CTL_REG EQU CYREG_B0_UDB09_10_ACTL
LCD_RST_Sync_ctrl_reg__16BIT_CONTROL_CONTROL_REG EQU CYREG_B0_UDB09_10_CTL
LCD_RST_Sync_ctrl_reg__16BIT_CONTROL_COUNT_REG EQU CYREG_B0_UDB09_10_CTL
LCD_RST_Sync_ctrl_reg__16BIT_COUNT_CONTROL_REG EQU CYREG_B0_UDB09_10_CTL
LCD_RST_Sync_ctrl_reg__16BIT_COUNT_COUNT_REG EQU CYREG_B0_UDB09_10_CTL
LCD_RST_Sync_ctrl_reg__16BIT_MASK_MASK_REG EQU CYREG_B0_UDB09_10_MSK
LCD_RST_Sync_ctrl_reg__16BIT_MASK_PERIOD_REG EQU CYREG_B0_UDB09_10_MSK
LCD_RST_Sync_ctrl_reg__16BIT_PERIOD_MASK_REG EQU CYREG_B0_UDB09_10_MSK
LCD_RST_Sync_ctrl_reg__16BIT_PERIOD_PERIOD_REG EQU CYREG_B0_UDB09_10_MSK
LCD_RST_Sync_ctrl_reg__CONTROL_AUX_CTL_REG EQU CYREG_B0_UDB09_ACTL
LCD_RST_Sync_ctrl_reg__CONTROL_REG EQU CYREG_B0_UDB09_CTL
LCD_RST_Sync_ctrl_reg__CONTROL_ST_REG EQU CYREG_B0_UDB09_ST_CTL
LCD_RST_Sync_ctrl_reg__COUNT_REG EQU CYREG_B0_UDB09_CTL
LCD_RST_Sync_ctrl_reg__COUNT_ST_REG EQU CYREG_B0_UDB09_ST_CTL
LCD_RST_Sync_ctrl_reg__MASK EQU 0x01
LCD_RST_Sync_ctrl_reg__MASK_CTL_AUX_CTL_REG EQU CYREG_B0_UDB09_MSK_ACTL
LCD_RST_Sync_ctrl_reg__PERIOD_REG EQU CYREG_B0_UDB09_MSK
LCD_RST_Sync_ctrl_reg__PER_CTL_AUX_CTL_REG EQU CYREG_B0_UDB09_MSK_ACTL

; Miscellaneous
; -- WARNING: define names containing LEOPARD or PANTHER are deprecated and will be removed in a future release
CYDEV_DEBUGGING_DPS_SWD_SWV EQU 6
CYDEV_CONFIG_UNUSED_IO_AllowButWarn EQU 0
CYDEV_CONFIGURATION_MODE_COMPRESSED EQU 0
CYDEV_CONFIG_FASTBOOT_ENABLED EQU 1
CYDEV_CHIP_REV_PSOC5LP_PRODUCTION EQU 0
CYDEV_CHIP_REVISION_5B_PRODUCTION EQU 0
CYDEV_CHIP_MEMBER_5B EQU 4
CYDEV_CHIP_FAMILY_PSOC5 EQU 3
CYDEV_CHIP_DIE_PSOC5LP EQU 4
CYDEV_CHIP_DIE_EXPECT EQU CYDEV_CHIP_DIE_PSOC5LP
BCLK__BUS_CLK__HZ EQU 24000000
BCLK__BUS_CLK__KHZ EQU 24000
BCLK__BUS_CLK__MHZ EQU 24
CYDEV_CHIP_DIE_ACTUAL EQU CYDEV_CHIP_DIE_EXPECT
CYDEV_CHIP_DIE_LEOPARD EQU 1
CYDEV_CHIP_DIE_PANTHER EQU 3
CYDEV_CHIP_DIE_PSOC4A EQU 2
CYDEV_CHIP_DIE_UNKNOWN EQU 0
CYDEV_CHIP_FAMILY_PSOC3 EQU 1
CYDEV_CHIP_FAMILY_PSOC4 EQU 2
CYDEV_CHIP_FAMILY_UNKNOWN EQU 0
CYDEV_CHIP_FAMILY_USED EQU CYDEV_CHIP_FAMILY_PSOC5
CYDEV_CHIP_JTAG_ID EQU 0x2E123069
CYDEV_CHIP_MEMBER_3A EQU 1
CYDEV_CHIP_MEMBER_4A EQU 2
CYDEV_CHIP_MEMBER_5A EQU 3
CYDEV_CHIP_MEMBER_UNKNOWN EQU 0
CYDEV_CHIP_MEMBER_USED EQU CYDEV_CHIP_MEMBER_5B
CYDEV_CHIP_REVISION_3A_ES1 EQU 0
CYDEV_CHIP_REVISION_3A_ES2 EQU 1
CYDEV_CHIP_REVISION_3A_ES3 EQU 3
CYDEV_CHIP_REVISION_3A_PRODUCTION EQU 3
CYDEV_CHIP_REVISION_4A_ES0 EQU 17
CYDEV_CHIP_REVISION_4A_PRODUCTION EQU 17
CYDEV_CHIP_REVISION_5A_ES0 EQU 0
CYDEV_CHIP_REVISION_5A_ES1 EQU 1
CYDEV_CHIP_REVISION_5A_PRODUCTION EQU 1
CYDEV_CHIP_REVISION_5B_ES0 EQU 0
CYDEV_CHIP_REVISION_USED EQU CYDEV_CHIP_REVISION_5B_PRODUCTION
CYDEV_CHIP_REV_EXPECT EQU CYDEV_CHIP_REV_PSOC5LP_PRODUCTION
CYDEV_CHIP_REV_LEOPARD_ES1 EQU 0
CYDEV_CHIP_REV_LEOPARD_ES2 EQU 1
CYDEV_CHIP_REV_LEOPARD_ES3 EQU 3
CYDEV_CHIP_REV_LEOPARD_PRODUCTION EQU 3
CYDEV_CHIP_REV_PANTHER_ES0 EQU 0
CYDEV_CHIP_REV_PANTHER_ES1 EQU 1
CYDEV_CHIP_REV_PANTHER_PRODUCTION EQU 1
CYDEV_CHIP_REV_PSOC4A_ES0 EQU 17
CYDEV_CHIP_REV_PSOC4A_PRODUCTION EQU 17
CYDEV_CHIP_REV_PSOC5LP_ES0 EQU 0
CYDEV_CONFIGURATION_COMPRESSED EQU 1
CYDEV_CONFIGURATION_DMA EQU 0
CYDEV_CONFIGURATION_ECC EQU 1
CYDEV_CONFIGURATION_IMOENABLED EQU CYDEV_CONFIG_FASTBOOT_ENABLED
CYDEV_CONFIGURATION_MODE EQU CYDEV_CONFIGURATION_MODE_COMPRESSED
CYDEV_CONFIGURATION_MODE_DMA EQU 2
CYDEV_CONFIGURATION_MODE_UNCOMPRESSED EQU 1
CYDEV_CONFIG_UNUSED_IO EQU CYDEV_CONFIG_UNUSED_IO_AllowButWarn
CYDEV_CONFIG_UNUSED_IO_AllowWithInfo EQU 1
CYDEV_CONFIG_UNUSED_IO_Disallowed EQU 2
CYDEV_DEBUGGING_DPS EQU CYDEV_DEBUGGING_DPS_SWD_SWV
CYDEV_DEBUGGING_DPS_Disable EQU 3
CYDEV_DEBUGGING_DPS_JTAG_4 EQU 1
CYDEV_DEBUGGING_DPS_JTAG_5 EQU 0
CYDEV_DEBUGGING_DPS_SWD EQU 2
CYDEV_DEBUGGING_ENABLE EQU 1
CYDEV_DEBUGGING_REQXRES EQU 1
CYDEV_DEBUGGING_XRES EQU 0
CYDEV_DEBUG_ENABLE_MASK EQU 0x20
CYDEV_DEBUG_ENABLE_REGISTER EQU CYREG_MLOGIC_DEBUG
CYDEV_DMA_CHANNELS_AVAILABLE EQU 24
CYDEV_ECC_ENABLE EQU 0
CYDEV_HEAP_SIZE EQU 0x1000
CYDEV_INSTRUCT_CACHE_ENABLED EQU 1
CYDEV_INTR_RISING EQU 0x00000000
CYDEV_PROJ_TYPE EQU 0
CYDEV_PROJ_TYPE_BOOTLOADER EQU 1
CYDEV_PROJ_TYPE_LOADABLE EQU 2
CYDEV_PROJ_TYPE_MULTIAPPBOOTLOADER EQU 3
CYDEV_PROJ_TYPE_STANDARD EQU 0
CYDEV_PROTECTION_ENABLE EQU 0
CYDEV_STACK_SIZE EQU 0x4000
CYDEV_USE_BUNDLED_CMSIS EQU 1
CYDEV_VARIABLE_VDDA EQU 0
CYDEV_VDDA_MV EQU 5000
CYDEV_VDDD_MV EQU 5000
CYDEV_VDDIO0_MV EQU 5000
CYDEV_VDDIO1_MV EQU 5000
CYDEV_VDDIO2_MV EQU 5000
CYDEV_VDDIO3_MV EQU 5000
CYDEV_VIO0 EQU 5
CYDEV_VIO0_MV EQU 5000
CYDEV_VIO1 EQU 5
CYDEV_VIO1_MV EQU 5000
CYDEV_VIO2 EQU 5
CYDEV_VIO2_MV EQU 5000
CYDEV_VIO3 EQU 5
CYDEV_VIO3_MV EQU 5000
DMA_CHANNELS_USED__MASK0 EQU 0x00000000
CYDEV_BOOTLOADER_ENABLE EQU 0
    ENDIF
    END
