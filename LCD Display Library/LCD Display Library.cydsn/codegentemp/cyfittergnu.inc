.ifndef INCLUDED_CYFITTERGNU_INC
.set INCLUDED_CYFITTERGNU_INC, 1
.include "cydevicegnu.inc"
.include "cydevicegnu_trm.inc"

/* LCD_Interface */
.set LCD_Interface__0__MASK, 0x10
.set LCD_Interface__0__PC, CYREG_PRT12_PC4
.set LCD_Interface__0__PORT, 12
.set LCD_Interface__0__SHIFT, 4
.set LCD_Interface__1__MASK, 0x08
.set LCD_Interface__1__PC, CYREG_PRT12_PC3
.set LCD_Interface__1__PORT, 12
.set LCD_Interface__1__SHIFT, 3
.set LCD_Interface__2__MASK, 0x80
.set LCD_Interface__2__PC, CYREG_PRT12_PC7
.set LCD_Interface__2__PORT, 12
.set LCD_Interface__2__SHIFT, 7
.set LCD_Interface__3__MASK, 0x20
.set LCD_Interface__3__PC, CYREG_PRT12_PC5
.set LCD_Interface__3__PORT, 12
.set LCD_Interface__3__SHIFT, 5
.set LCD_Interface__4__MASK, 0x40
.set LCD_Interface__4__PC, CYREG_PRT12_PC6
.set LCD_Interface__4__PORT, 12
.set LCD_Interface__4__SHIFT, 6
.set LCD_Interface__AG, CYREG_PRT12_AG
.set LCD_Interface__BIE, CYREG_PRT12_BIE
.set LCD_Interface__BIT_MASK, CYREG_PRT12_BIT_MASK
.set LCD_Interface__BYP, CYREG_PRT12_BYP
.set LCD_Interface__DM0, CYREG_PRT12_DM0
.set LCD_Interface__DM1, CYREG_PRT12_DM1
.set LCD_Interface__DM2, CYREG_PRT12_DM2
.set LCD_Interface__DR, CYREG_PRT12_DR
.set LCD_Interface__D_C__MASK, 0x20
.set LCD_Interface__D_C__PC, CYREG_PRT12_PC5
.set LCD_Interface__D_C__PORT, 12
.set LCD_Interface__D_C__SHIFT, 5
.set LCD_Interface__INP_DIS, CYREG_PRT12_INP_DIS
.set LCD_Interface__PORT, 12
.set LCD_Interface__PRT, CYREG_PRT12_PRT
.set LCD_Interface__PRTDSI__DBL_SYNC_IN, CYREG_PRT12_DBL_SYNC_IN
.set LCD_Interface__PRTDSI__OE_SEL0, CYREG_PRT12_OE_SEL0
.set LCD_Interface__PRTDSI__OE_SEL1, CYREG_PRT12_OE_SEL1
.set LCD_Interface__PRTDSI__OUT_SEL0, CYREG_PRT12_OUT_SEL0
.set LCD_Interface__PRTDSI__OUT_SEL1, CYREG_PRT12_OUT_SEL1
.set LCD_Interface__PRTDSI__SYNC_OUT, CYREG_PRT12_SYNC_OUT
.set LCD_Interface__PS, CYREG_PRT12_PS
.set LCD_Interface__RST__MASK, 0x40
.set LCD_Interface__RST__PC, CYREG_PRT12_PC6
.set LCD_Interface__RST__PORT, 12
.set LCD_Interface__RST__SHIFT, 6
.set LCD_Interface__SCE__MASK, 0x80
.set LCD_Interface__SCE__PC, CYREG_PRT12_PC7
.set LCD_Interface__SCE__PORT, 12
.set LCD_Interface__SCE__SHIFT, 7
.set LCD_Interface__SCLK__MASK, 0x08
.set LCD_Interface__SCLK__PC, CYREG_PRT12_PC3
.set LCD_Interface__SCLK__PORT, 12
.set LCD_Interface__SCLK__SHIFT, 3
.set LCD_Interface__SDIN__MASK, 0x10
.set LCD_Interface__SDIN__PC, CYREG_PRT12_PC4
.set LCD_Interface__SDIN__PORT, 12
.set LCD_Interface__SDIN__SHIFT, 4
.set LCD_Interface__SIO_CFG, CYREG_PRT12_SIO_CFG
.set LCD_Interface__SIO_DIFF, CYREG_PRT12_SIO_DIFF
.set LCD_Interface__SIO_HYST_EN, CYREG_PRT12_SIO_HYST_EN
.set LCD_Interface__SIO_REG_HIFREQ, CYREG_PRT12_SIO_REG_HIFREQ
.set LCD_Interface__SLW, CYREG_PRT12_SLW

/* SPIM_IntClock */
.set SPIM_IntClock__CFG0, CYREG_CLKDIST_DCFG0_CFG0
.set SPIM_IntClock__CFG1, CYREG_CLKDIST_DCFG0_CFG1
.set SPIM_IntClock__CFG2, CYREG_CLKDIST_DCFG0_CFG2
.set SPIM_IntClock__CFG2_SRC_SEL_MASK, 0x07
.set SPIM_IntClock__INDEX, 0x00
.set SPIM_IntClock__PM_ACT_CFG, CYREG_PM_ACT_CFG2
.set SPIM_IntClock__PM_ACT_MSK, 0x01
.set SPIM_IntClock__PM_STBY_CFG, CYREG_PM_STBY_CFG2
.set SPIM_IntClock__PM_STBY_MSK, 0x01

/* Data_CMD_Sel */
.set Data_CMD_Sel_Sync_ctrl_reg__0__MASK, 0x01
.set Data_CMD_Sel_Sync_ctrl_reg__0__POS, 0
.set Data_CMD_Sel_Sync_ctrl_reg__16BIT_CONTROL_AUX_CTL_REG, CYREG_B1_UDB08_09_ACTL
.set Data_CMD_Sel_Sync_ctrl_reg__16BIT_CONTROL_CONTROL_REG, CYREG_B1_UDB08_09_CTL
.set Data_CMD_Sel_Sync_ctrl_reg__16BIT_CONTROL_COUNT_REG, CYREG_B1_UDB08_09_CTL
.set Data_CMD_Sel_Sync_ctrl_reg__16BIT_COUNT_CONTROL_REG, CYREG_B1_UDB08_09_CTL
.set Data_CMD_Sel_Sync_ctrl_reg__16BIT_COUNT_COUNT_REG, CYREG_B1_UDB08_09_CTL
.set Data_CMD_Sel_Sync_ctrl_reg__16BIT_MASK_MASK_REG, CYREG_B1_UDB08_09_MSK
.set Data_CMD_Sel_Sync_ctrl_reg__16BIT_MASK_PERIOD_REG, CYREG_B1_UDB08_09_MSK
.set Data_CMD_Sel_Sync_ctrl_reg__16BIT_PERIOD_MASK_REG, CYREG_B1_UDB08_09_MSK
.set Data_CMD_Sel_Sync_ctrl_reg__16BIT_PERIOD_PERIOD_REG, CYREG_B1_UDB08_09_MSK
.set Data_CMD_Sel_Sync_ctrl_reg__CONTROL_AUX_CTL_REG, CYREG_B1_UDB08_ACTL
.set Data_CMD_Sel_Sync_ctrl_reg__CONTROL_REG, CYREG_B1_UDB08_CTL
.set Data_CMD_Sel_Sync_ctrl_reg__CONTROL_ST_REG, CYREG_B1_UDB08_ST_CTL
.set Data_CMD_Sel_Sync_ctrl_reg__COUNT_REG, CYREG_B1_UDB08_CTL
.set Data_CMD_Sel_Sync_ctrl_reg__COUNT_ST_REG, CYREG_B1_UDB08_ST_CTL
.set Data_CMD_Sel_Sync_ctrl_reg__MASK, 0x01
.set Data_CMD_Sel_Sync_ctrl_reg__MASK_CTL_AUX_CTL_REG, CYREG_B1_UDB08_MSK_ACTL
.set Data_CMD_Sel_Sync_ctrl_reg__PERIOD_REG, CYREG_B1_UDB08_MSK
.set Data_CMD_Sel_Sync_ctrl_reg__PER_CTL_AUX_CTL_REG, CYREG_B1_UDB08_MSK_ACTL

/* SPIM_BSPIM */
.set SPIM_BSPIM_BitCounter_ST__16BIT_STATUS_AUX_CTL_REG, CYREG_B0_UDB08_09_ACTL
.set SPIM_BSPIM_BitCounter_ST__16BIT_STATUS_REG, CYREG_B0_UDB08_09_ST
.set SPIM_BSPIM_BitCounter_ST__MASK_REG, CYREG_B0_UDB08_MSK
.set SPIM_BSPIM_BitCounter_ST__MASK_ST_AUX_CTL_REG, CYREG_B0_UDB08_MSK_ACTL
.set SPIM_BSPIM_BitCounter_ST__PER_ST_AUX_CTL_REG, CYREG_B0_UDB08_MSK_ACTL
.set SPIM_BSPIM_BitCounter_ST__STATUS_AUX_CTL_REG, CYREG_B0_UDB08_ACTL
.set SPIM_BSPIM_BitCounter_ST__STATUS_CNT_REG, CYREG_B0_UDB08_ST_CTL
.set SPIM_BSPIM_BitCounter_ST__STATUS_CONTROL_REG, CYREG_B0_UDB08_ST_CTL
.set SPIM_BSPIM_BitCounter_ST__STATUS_REG, CYREG_B0_UDB08_ST
.set SPIM_BSPIM_BitCounter__16BIT_CONTROL_AUX_CTL_REG, CYREG_B0_UDB08_09_ACTL
.set SPIM_BSPIM_BitCounter__16BIT_CONTROL_CONTROL_REG, CYREG_B0_UDB08_09_CTL
.set SPIM_BSPIM_BitCounter__16BIT_CONTROL_COUNT_REG, CYREG_B0_UDB08_09_CTL
.set SPIM_BSPIM_BitCounter__16BIT_COUNT_CONTROL_REG, CYREG_B0_UDB08_09_CTL
.set SPIM_BSPIM_BitCounter__16BIT_COUNT_COUNT_REG, CYREG_B0_UDB08_09_CTL
.set SPIM_BSPIM_BitCounter__16BIT_MASK_MASK_REG, CYREG_B0_UDB08_09_MSK
.set SPIM_BSPIM_BitCounter__16BIT_MASK_PERIOD_REG, CYREG_B0_UDB08_09_MSK
.set SPIM_BSPIM_BitCounter__16BIT_PERIOD_MASK_REG, CYREG_B0_UDB08_09_MSK
.set SPIM_BSPIM_BitCounter__16BIT_PERIOD_PERIOD_REG, CYREG_B0_UDB08_09_MSK
.set SPIM_BSPIM_BitCounter__CONTROL_AUX_CTL_REG, CYREG_B0_UDB08_ACTL
.set SPIM_BSPIM_BitCounter__CONTROL_REG, CYREG_B0_UDB08_CTL
.set SPIM_BSPIM_BitCounter__CONTROL_ST_REG, CYREG_B0_UDB08_ST_CTL
.set SPIM_BSPIM_BitCounter__COUNT_REG, CYREG_B0_UDB08_CTL
.set SPIM_BSPIM_BitCounter__COUNT_ST_REG, CYREG_B0_UDB08_ST_CTL
.set SPIM_BSPIM_BitCounter__MASK_CTL_AUX_CTL_REG, CYREG_B0_UDB08_MSK_ACTL
.set SPIM_BSPIM_BitCounter__PERIOD_REG, CYREG_B0_UDB08_MSK
.set SPIM_BSPIM_BitCounter__PER_CTL_AUX_CTL_REG, CYREG_B0_UDB08_MSK_ACTL
.set SPIM_BSPIM_RxStsReg__16BIT_STATUS_AUX_CTL_REG, CYREG_B1_UDB08_09_ACTL
.set SPIM_BSPIM_RxStsReg__16BIT_STATUS_REG, CYREG_B1_UDB08_09_ST
.set SPIM_BSPIM_RxStsReg__4__MASK, 0x10
.set SPIM_BSPIM_RxStsReg__4__POS, 4
.set SPIM_BSPIM_RxStsReg__5__MASK, 0x20
.set SPIM_BSPIM_RxStsReg__5__POS, 5
.set SPIM_BSPIM_RxStsReg__6__MASK, 0x40
.set SPIM_BSPIM_RxStsReg__6__POS, 6
.set SPIM_BSPIM_RxStsReg__MASK, 0x70
.set SPIM_BSPIM_RxStsReg__MASK_REG, CYREG_B1_UDB08_MSK
.set SPIM_BSPIM_RxStsReg__MASK_ST_AUX_CTL_REG, CYREG_B1_UDB08_MSK_ACTL
.set SPIM_BSPIM_RxStsReg__PER_ST_AUX_CTL_REG, CYREG_B1_UDB08_MSK_ACTL
.set SPIM_BSPIM_RxStsReg__STATUS_AUX_CTL_REG, CYREG_B1_UDB08_ACTL
.set SPIM_BSPIM_RxStsReg__STATUS_CNT_REG, CYREG_B1_UDB08_ST_CTL
.set SPIM_BSPIM_RxStsReg__STATUS_CONTROL_REG, CYREG_B1_UDB08_ST_CTL
.set SPIM_BSPIM_RxStsReg__STATUS_REG, CYREG_B1_UDB08_ST
.set SPIM_BSPIM_TxStsReg__0__MASK, 0x01
.set SPIM_BSPIM_TxStsReg__0__POS, 0
.set SPIM_BSPIM_TxStsReg__16BIT_STATUS_AUX_CTL_REG, CYREG_B1_UDB09_10_ACTL
.set SPIM_BSPIM_TxStsReg__16BIT_STATUS_REG, CYREG_B1_UDB09_10_ST
.set SPIM_BSPIM_TxStsReg__1__MASK, 0x02
.set SPIM_BSPIM_TxStsReg__1__POS, 1
.set SPIM_BSPIM_TxStsReg__2__MASK, 0x04
.set SPIM_BSPIM_TxStsReg__2__POS, 2
.set SPIM_BSPIM_TxStsReg__3__MASK, 0x08
.set SPIM_BSPIM_TxStsReg__3__POS, 3
.set SPIM_BSPIM_TxStsReg__4__MASK, 0x10
.set SPIM_BSPIM_TxStsReg__4__POS, 4
.set SPIM_BSPIM_TxStsReg__MASK, 0x1F
.set SPIM_BSPIM_TxStsReg__MASK_REG, CYREG_B1_UDB09_MSK
.set SPIM_BSPIM_TxStsReg__STATUS_AUX_CTL_REG, CYREG_B1_UDB09_ACTL
.set SPIM_BSPIM_TxStsReg__STATUS_REG, CYREG_B1_UDB09_ST
.set SPIM_BSPIM_sR8_Dp_u0__16BIT_A0_REG, CYREG_B0_UDB08_09_A0
.set SPIM_BSPIM_sR8_Dp_u0__16BIT_A1_REG, CYREG_B0_UDB08_09_A1
.set SPIM_BSPIM_sR8_Dp_u0__16BIT_D0_REG, CYREG_B0_UDB08_09_D0
.set SPIM_BSPIM_sR8_Dp_u0__16BIT_D1_REG, CYREG_B0_UDB08_09_D1
.set SPIM_BSPIM_sR8_Dp_u0__16BIT_DP_AUX_CTL_REG, CYREG_B0_UDB08_09_ACTL
.set SPIM_BSPIM_sR8_Dp_u0__16BIT_F0_REG, CYREG_B0_UDB08_09_F0
.set SPIM_BSPIM_sR8_Dp_u0__16BIT_F1_REG, CYREG_B0_UDB08_09_F1
.set SPIM_BSPIM_sR8_Dp_u0__A0_A1_REG, CYREG_B0_UDB08_A0_A1
.set SPIM_BSPIM_sR8_Dp_u0__A0_REG, CYREG_B0_UDB08_A0
.set SPIM_BSPIM_sR8_Dp_u0__A1_REG, CYREG_B0_UDB08_A1
.set SPIM_BSPIM_sR8_Dp_u0__D0_D1_REG, CYREG_B0_UDB08_D0_D1
.set SPIM_BSPIM_sR8_Dp_u0__D0_REG, CYREG_B0_UDB08_D0
.set SPIM_BSPIM_sR8_Dp_u0__D1_REG, CYREG_B0_UDB08_D1
.set SPIM_BSPIM_sR8_Dp_u0__DP_AUX_CTL_REG, CYREG_B0_UDB08_ACTL
.set SPIM_BSPIM_sR8_Dp_u0__F0_F1_REG, CYREG_B0_UDB08_F0_F1
.set SPIM_BSPIM_sR8_Dp_u0__F0_REG, CYREG_B0_UDB08_F0
.set SPIM_BSPIM_sR8_Dp_u0__F1_REG, CYREG_B0_UDB08_F1
.set SPIM_BSPIM_sR8_Dp_u0__MSK_DP_AUX_CTL_REG, CYREG_B0_UDB08_MSK_ACTL
.set SPIM_BSPIM_sR8_Dp_u0__PER_DP_AUX_CTL_REG, CYREG_B0_UDB08_MSK_ACTL

/* LCD_RST */
.set LCD_RST_Sync_ctrl_reg__0__MASK, 0x01
.set LCD_RST_Sync_ctrl_reg__0__POS, 0
.set LCD_RST_Sync_ctrl_reg__16BIT_CONTROL_AUX_CTL_REG, CYREG_B0_UDB09_10_ACTL
.set LCD_RST_Sync_ctrl_reg__16BIT_CONTROL_CONTROL_REG, CYREG_B0_UDB09_10_CTL
.set LCD_RST_Sync_ctrl_reg__16BIT_CONTROL_COUNT_REG, CYREG_B0_UDB09_10_CTL
.set LCD_RST_Sync_ctrl_reg__16BIT_COUNT_CONTROL_REG, CYREG_B0_UDB09_10_CTL
.set LCD_RST_Sync_ctrl_reg__16BIT_COUNT_COUNT_REG, CYREG_B0_UDB09_10_CTL
.set LCD_RST_Sync_ctrl_reg__16BIT_MASK_MASK_REG, CYREG_B0_UDB09_10_MSK
.set LCD_RST_Sync_ctrl_reg__16BIT_MASK_PERIOD_REG, CYREG_B0_UDB09_10_MSK
.set LCD_RST_Sync_ctrl_reg__16BIT_PERIOD_MASK_REG, CYREG_B0_UDB09_10_MSK
.set LCD_RST_Sync_ctrl_reg__16BIT_PERIOD_PERIOD_REG, CYREG_B0_UDB09_10_MSK
.set LCD_RST_Sync_ctrl_reg__CONTROL_AUX_CTL_REG, CYREG_B0_UDB09_ACTL
.set LCD_RST_Sync_ctrl_reg__CONTROL_REG, CYREG_B0_UDB09_CTL
.set LCD_RST_Sync_ctrl_reg__CONTROL_ST_REG, CYREG_B0_UDB09_ST_CTL
.set LCD_RST_Sync_ctrl_reg__COUNT_REG, CYREG_B0_UDB09_CTL
.set LCD_RST_Sync_ctrl_reg__COUNT_ST_REG, CYREG_B0_UDB09_ST_CTL
.set LCD_RST_Sync_ctrl_reg__MASK, 0x01
.set LCD_RST_Sync_ctrl_reg__MASK_CTL_AUX_CTL_REG, CYREG_B0_UDB09_MSK_ACTL
.set LCD_RST_Sync_ctrl_reg__PERIOD_REG, CYREG_B0_UDB09_MSK
.set LCD_RST_Sync_ctrl_reg__PER_CTL_AUX_CTL_REG, CYREG_B0_UDB09_MSK_ACTL

/* Miscellaneous */
/* -- WARNING: define names containing LEOPARD or PANTHER are deprecated and will be removed in a future release */
.set CYDEV_DEBUGGING_DPS_SWD_SWV, 6
.set CYDEV_CONFIG_UNUSED_IO_AllowButWarn, 0
.set CYDEV_CONFIGURATION_MODE_COMPRESSED, 0
.set CYDEV_CONFIG_FASTBOOT_ENABLED, 1
.set CYDEV_CHIP_REV_PSOC5LP_PRODUCTION, 0
.set CYDEV_CHIP_REVISION_5B_PRODUCTION, 0
.set CYDEV_CHIP_MEMBER_5B, 4
.set CYDEV_CHIP_FAMILY_PSOC5, 3
.set CYDEV_CHIP_DIE_PSOC5LP, 4
.set CYDEV_CHIP_DIE_EXPECT, CYDEV_CHIP_DIE_PSOC5LP
.set BCLK__BUS_CLK__HZ, 24000000
.set BCLK__BUS_CLK__KHZ, 24000
.set BCLK__BUS_CLK__MHZ, 24
.set CYDEV_CHIP_DIE_ACTUAL, CYDEV_CHIP_DIE_EXPECT
.set CYDEV_CHIP_DIE_LEOPARD, 1
.set CYDEV_CHIP_DIE_PANTHER, 3
.set CYDEV_CHIP_DIE_PSOC4A, 2
.set CYDEV_CHIP_DIE_UNKNOWN, 0
.set CYDEV_CHIP_FAMILY_PSOC3, 1
.set CYDEV_CHIP_FAMILY_PSOC4, 2
.set CYDEV_CHIP_FAMILY_UNKNOWN, 0
.set CYDEV_CHIP_FAMILY_USED, CYDEV_CHIP_FAMILY_PSOC5
.set CYDEV_CHIP_JTAG_ID, 0x2E123069
.set CYDEV_CHIP_MEMBER_3A, 1
.set CYDEV_CHIP_MEMBER_4A, 2
.set CYDEV_CHIP_MEMBER_5A, 3
.set CYDEV_CHIP_MEMBER_UNKNOWN, 0
.set CYDEV_CHIP_MEMBER_USED, CYDEV_CHIP_MEMBER_5B
.set CYDEV_CHIP_REVISION_3A_ES1, 0
.set CYDEV_CHIP_REVISION_3A_ES2, 1
.set CYDEV_CHIP_REVISION_3A_ES3, 3
.set CYDEV_CHIP_REVISION_3A_PRODUCTION, 3
.set CYDEV_CHIP_REVISION_4A_ES0, 17
.set CYDEV_CHIP_REVISION_4A_PRODUCTION, 17
.set CYDEV_CHIP_REVISION_5A_ES0, 0
.set CYDEV_CHIP_REVISION_5A_ES1, 1
.set CYDEV_CHIP_REVISION_5A_PRODUCTION, 1
.set CYDEV_CHIP_REVISION_5B_ES0, 0
.set CYDEV_CHIP_REVISION_USED, CYDEV_CHIP_REVISION_5B_PRODUCTION
.set CYDEV_CHIP_REV_EXPECT, CYDEV_CHIP_REV_PSOC5LP_PRODUCTION
.set CYDEV_CHIP_REV_LEOPARD_ES1, 0
.set CYDEV_CHIP_REV_LEOPARD_ES2, 1
.set CYDEV_CHIP_REV_LEOPARD_ES3, 3
.set CYDEV_CHIP_REV_LEOPARD_PRODUCTION, 3
.set CYDEV_CHIP_REV_PANTHER_ES0, 0
.set CYDEV_CHIP_REV_PANTHER_ES1, 1
.set CYDEV_CHIP_REV_PANTHER_PRODUCTION, 1
.set CYDEV_CHIP_REV_PSOC4A_ES0, 17
.set CYDEV_CHIP_REV_PSOC4A_PRODUCTION, 17
.set CYDEV_CHIP_REV_PSOC5LP_ES0, 0
.set CYDEV_CONFIGURATION_COMPRESSED, 1
.set CYDEV_CONFIGURATION_DMA, 0
.set CYDEV_CONFIGURATION_ECC, 1
.set CYDEV_CONFIGURATION_IMOENABLED, CYDEV_CONFIG_FASTBOOT_ENABLED
.set CYDEV_CONFIGURATION_MODE, CYDEV_CONFIGURATION_MODE_COMPRESSED
.set CYDEV_CONFIGURATION_MODE_DMA, 2
.set CYDEV_CONFIGURATION_MODE_UNCOMPRESSED, 1
.set CYDEV_CONFIG_UNUSED_IO, CYDEV_CONFIG_UNUSED_IO_AllowButWarn
.set CYDEV_CONFIG_UNUSED_IO_AllowWithInfo, 1
.set CYDEV_CONFIG_UNUSED_IO_Disallowed, 2
.set CYDEV_DEBUGGING_DPS, CYDEV_DEBUGGING_DPS_SWD_SWV
.set CYDEV_DEBUGGING_DPS_Disable, 3
.set CYDEV_DEBUGGING_DPS_JTAG_4, 1
.set CYDEV_DEBUGGING_DPS_JTAG_5, 0
.set CYDEV_DEBUGGING_DPS_SWD, 2
.set CYDEV_DEBUGGING_ENABLE, 1
.set CYDEV_DEBUGGING_REQXRES, 1
.set CYDEV_DEBUGGING_XRES, 0
.set CYDEV_DEBUG_ENABLE_MASK, 0x20
.set CYDEV_DEBUG_ENABLE_REGISTER, CYREG_MLOGIC_DEBUG
.set CYDEV_DMA_CHANNELS_AVAILABLE, 24
.set CYDEV_ECC_ENABLE, 0
.set CYDEV_HEAP_SIZE, 0x1000
.set CYDEV_INSTRUCT_CACHE_ENABLED, 1
.set CYDEV_INTR_RISING, 0x00000000
.set CYDEV_PROJ_TYPE, 0
.set CYDEV_PROJ_TYPE_BOOTLOADER, 1
.set CYDEV_PROJ_TYPE_LOADABLE, 2
.set CYDEV_PROJ_TYPE_MULTIAPPBOOTLOADER, 3
.set CYDEV_PROJ_TYPE_STANDARD, 0
.set CYDEV_PROTECTION_ENABLE, 0
.set CYDEV_STACK_SIZE, 0x4000
.set CYDEV_USE_BUNDLED_CMSIS, 1
.set CYDEV_VARIABLE_VDDA, 0
.set CYDEV_VDDA_MV, 5000
.set CYDEV_VDDD_MV, 5000
.set CYDEV_VDDIO0_MV, 5000
.set CYDEV_VDDIO1_MV, 5000
.set CYDEV_VDDIO2_MV, 5000
.set CYDEV_VDDIO3_MV, 5000
.set CYDEV_VIO0, 5
.set CYDEV_VIO0_MV, 5000
.set CYDEV_VIO1, 5
.set CYDEV_VIO1_MV, 5000
.set CYDEV_VIO2, 5
.set CYDEV_VIO2_MV, 5000
.set CYDEV_VIO3, 5
.set CYDEV_VIO3_MV, 5000
.set DMA_CHANNELS_USED__MASK0, 0x00000000
.set CYDEV_BOOTLOADER_ENABLE, 0
.endif
